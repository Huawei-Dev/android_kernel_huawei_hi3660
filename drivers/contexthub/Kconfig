## drivers/contexthub/Kconfig
```kconfig
config CONTEXTHUB
	bool "Sensor CONTEXTHUB driver"
	depends on INPUTHUB || INPUTHUB_20
	default n
	help
	Sensor CONTEXTHUB driver.

config CONTEXTHUB_SHMEM
	bool "Sensor CONTEXTHUB SHMEM driver"
	depends on INPUTHUB || INPUTHUB_20
	default y
	help
	Say yes here if you want to configure contexthub share memory

source "drivers/contexthub/flp/Kconfig"
```

## drivers/cpufreq/hisi/Kconfig.arm
```kconfig
config HISI_CPUFREQ_DT
	bool "Hisilicon cpufreq-dt enable"
	depends on CPUFREQ_DT
	default n
	help
	  Hisilicon cpufreq-dt enable.

config HISI_CPU_FREQ_GOV_SCHEDUTIL
	bool "Hisilicon 'schedutil' cpufreq governor optimize"
	depends on CPU_FREQ_GOV_SCHEDUTIL
	default n
	help
	  This extends the functionality of existing schedutil governor.

config HISI_CPU_FREQ_LOCK_DETECT
	bool "Hisilicon schedutil detect freq lock&unlock"
	depends on HISI_CPU_FREQ_GOV_SCHEDUTIL
	default n
	help
	  This extends min_sample_time when boost scene finish
```

## drivers/devkit/tpkit/hostprocessing/Kconfig
```kconfig
#
# huawei hostprocessing ts driver configuration
#

menuconfig JDI_HOST_TS_KIT
	tristate "JDI_HOST ts drivers"
	default n
	help
	  If you say yes here you get support for jdi hostprocessing ts touchscreen.

menuconfig HUAWEI_THP
	tristate "HUAWEI thp core drivers"
	default n
	help
	  If you say yes here you get support for core capacity hostprocessing touchscreen.
```

## drivers/devkit/tpkit/panel/Kconfig
```kconfig
#
# huawei touchscreen driver configuration
#

source "drivers/devkit/tpkit/panel/synaptics/Kconfig"
source "drivers/devkit/tpkit/panel/parade/Kconfig"
source "drivers/devkit/tpkit/panel/novatek/Kconfig"
source "drivers/devkit/tpkit/panel/atmel/Kconfig"
source "drivers/devkit/tpkit/panel/wacom/Kconfig"
```

## drivers/hisi/ivp/Kconfig
```kconfig
menu "Hisilicon IVP"

config HISI_IVP
     bool "hisilicon ivp support"
     default n
     help
          ivp driver for ivpv100.

config IVP_SMMU
	bool "Hisilicon IVP SMMU Support"
	depends on IOMMU_API
	depends on HISI_IODOMAIN_API
	help
	  Hisilicon IVP IOMMU Support.

choice
	prompt "IVP Platform"
	depends on HISI_IVP
	help
	  select ivp platform private setting

config IVP_IVPV150
	bool "ivpv150"
	depends on HISI_IVP

endchoice
endmenu
```

## drivers/huawei_platform/power/buck_boost/Kconfig
```kconfig
#
# buck_boost drivers
#

config BUCKBOOST
	bool "buck boost"
	default n
	help
	  Say Y here to enable buck_boost driver.
	  This driver provides a unified interface to buck_boost.
	  This driver is in logic layer.
	  Currently supported device_check and set_vol etc.
```

## drivers/huawei_platform/usb/Kconfig
```kconfig
source "drivers/huawei_platform/usb/switch/Kconfig"
source "drivers/huawei_platform/usb/otg_gpio_switch/Kconfig"
source "drivers/huawei_platform/usb/typec/Kconfig"
source "drivers/huawei_platform/usb/pd/Kconfig"
source "drivers/huawei_platform/usb/superswitch/Kconfig"
source "drivers/huawei_platform/usb/sw/Kconfig"

config SUPERSWITCH
	tristate "superswitch support"
	help
	  Say Y here to enable superswitch support.
```

## kernel/sched/Kconfig
```kconfig
config SCHED_HISI_FORCE_CMP_BACKUP
	bool "Always consider backup cpu in non-preferidle case"
	depends on HISI_EAS_SCHED
	default n
	help
	  This option compares backup_cpu if target_cpu == prev_cpu.
	  In other words, for non-prefer idle tasks it may chose an idle
	  cpu even if prev_cpu is the best active cpu.
	  Not recommended because it will make all tasks spread.
```

## security/kernel_harden/Kconfig
```kconfig
#
# Huawei Kernel Harden
#

menu "Huawei Kernel Harden"

config HUAWEI_HIDESYMS
	bool "hide symbols"
	default n
	help
	Hide some sensitive kernel symbols
endmenu
#a blank line must be existed
```
